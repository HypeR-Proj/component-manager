## Kconfig
```kconfig
# SPDX-FileCopyrightText: 2026 roolrz
# SPDX-License-Identifier: Apache-2.0

config SYSTEM_APP_COMPONENT_MANAGER
    bool "component-manager (/svc/component-manager)"
    default y
    help
        Build and deploy hyper-component-manager at /svc/component-manager.
        Startup coordinator and service topology come from the selected profile.
```
